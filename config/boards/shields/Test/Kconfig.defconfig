## config/boards/shields/Test/Kconfig.defconfig
```kconfig
if SHIELD_TEST

config ZMK_KEYBOARD_NAME
    default "Test"

config ZMK_SPLIT
    default y

endif

if SHIELD_TEST_R

config ZMK_KEYBOARD_NAME
    default "Test_R"

config ZMK_SPLIT
    default y

config ZMK_SPLIT_ROLE_CENTRAL
    default y

endif
```

## config/boards/shields/Test/Kconfig.shield
```kconfig
config SHIELD_TEST
    def_bool $(shields_list_contains,Test)

config SHIELD_TEST_R
    def_bool $(shields_list_contains,Test_R)
```

## config/boards/shields/Test/config/Kconfig.shield
```kconfig
config SHIELD_TEST
    def_bool $(shields_list_contains,Test)

config SHIELD_TEST_RIGHT
    def_bool $(shields_list_contains,Test_right)

config SHIELD_TEST_LEFT
    def_bool $(shields_list_contains,Test_left)
```

## config/west.yml
```yaml
manifest:
  remotes:
    - name: zmkfirmware
      url-base: https://github.com/petejohanson
    - name: badjeff
      url-base: https://github.com/badjeff
    - name: carrefinho                           
      url-base: https://github.com/carrefinho     
    - name: kuma                        
      url-base: https://github.com/kumamuk-git
      
  projects:
    - name: zmk-pmw3610-driver
      remote: badjeff
      revision: main

    - name: zmk
      remote: zmkfirmware
      revision: feat/pointers-with-input-processors
      import: app/west.yml

    - name: prospector-zmk-module                
      remote: kuma                         
      revision: main                            
      
  self:
    path: config
```
